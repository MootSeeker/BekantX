## Firmware/ESP32C3/BekantX/components/bekantx_application/Kconfig.projbuild
```kconfig
menu "BekantX WiFi Manager"

    config WIFI_MGR_MAX_CONNECT_ATTEMPTS
        int "Maximum STA connect attempts before fallback to portal"
        range 1 20
        default 5
        help
            Number of failed connection attempts before the device switches
            to provisioning portal mode.

    config WIFI_MGR_CONNECT_TIMEOUT_MS
        int "Per-attempt connect timeout in milliseconds"
        range 5000 60000
        default 15000
        help
            Maximum time to wait for an IP address on each connection attempt.

    config WIFI_MGR_AP_SSID_PREFIX
        string "SoftAP SSID prefix for provisioning mode"
        default "BekantX-Setup-"
        help
            The SSID visible to the user during provisioning is this prefix
            followed by the last two bytes of the MAC address.

    config WIFI_MGR_AP_CHANNEL
        int "SoftAP Wi-Fi channel"
        range 1 13
        default 1

    config WIFI_MGR_AP_MAX_CONN
        int "SoftAP maximum simultaneous client connections"
        range 1 4
        default 2

    config WIFI_MGR_PORTAL_PORT
        int "HTTP provisioning portal port"
        range 1 65535
        default 80

    config WIFI_MGR_NVS_NAMESPACE
        string "NVS namespace for Wi-Fi credentials"
        default "wifi_mgr"
        help
            Dedicated NVS namespace used to store the SSID and password.
            Credentials are never logged to serial output.

endmenu
```

## Firmware/ESP32C3/BekantX/components/bekantx_mqtt/Kconfig.projbuild
```kconfig
menu "BekantX MQTT Service"

    config MQTT_BROKER_URI_DEFAULT
        string "Default MQTT broker URI (fallback when NVS is empty)"
        default "mqtt://homeassistant.local"
        help
            Default broker URI used when no credentials have been configured
            through the captive portal.  Format: mqtt://host or mqtts://host.

    config MQTT_TOPIC_PREFIX
        string "MQTT topic prefix"
        default "bekantx"
        help
            All topics are published/subscribed under {prefix}/{device_id}/...

    config MQTT_DEVICE_ID
        string "MQTT device identifier"
        default "desk001"
        help
            Unique device ID used in topic paths and HA discovery.

    config MQTT_KEEPALIVE_SEC
        int "MQTT keep-alive interval in seconds"
        range 10 600
        default 60

    config MQTT_CMD_QUEUE_DEPTH
        int "Command queue depth"
        range 2 32
        default 8
        help
            Maximum number of desk commands buffered before the SPI bridge
            consumes them.

    config MQTT_QOS
        int "Default MQTT QoS level"
        range 0 2
        default 1

    config MQTT_HA_DISCOVERY_ENABLED
        bool "Enable Home Assistant MQTT auto-discovery"
        default y
        help
            Publish a retained discovery config so the desk appears
            automatically in Home Assistant as a Cover entity.

    config MQTT_HA_DISCOVERY_PREFIX
        string "Home Assistant discovery topic prefix"
        default "homeassistant"
        depends on MQTT_HA_DISCOVERY_ENABLED

    config MQTT_NVS_NAMESPACE
        string "NVS namespace for MQTT credentials"
        default "mqtt_cfg"
        help
            Dedicated NVS namespace for broker URI, username and password.

endmenu

menu "BekantX Deep Sleep"

    config BEKANTX_SLEEP_ENABLED
        bool "Enable deep sleep on connection failure"
        default y
        help
            When enabled the device enters deep sleep after all Wi-Fi
            connection attempts are exhausted (only when stored credentials
            exist).  A GPIO button press wakes the device.

    config BEKANTX_SLEEP_WAKE_GPIO
        int "GPIO pin for deep-sleep wake button"
        range 0 21
        default 9
        depends on BEKANTX_SLEEP_ENABLED
        help
            GPIO connected to a button that wakes the ESP32-C3 from
            deep sleep.

    config BEKANTX_SLEEP_WAKE_LEVEL
        int "Wake GPIO active level (0 = LOW, 1 = HIGH)"
        range 0 1
        default 0
        depends on BEKANTX_SLEEP_ENABLED
        help
            GPIO level that triggers wake-up.  0 means the button pulls
            the pin LOW when pressed.

endmenu
```

## Firmware/ESP32C3/BekantX/sdkconfig.defaults
```kconfig
# Wi-Fi manager defaults
CONFIG_ESP_WIFI_NVS_ENABLED=y
CONFIG_HTTPD_MAX_REQ_HDR_LEN=1024
CONFIG_LWIP_DHCPS_MAX_STATION_NUM=4

# MQTT service defaults
CONFIG_MQTT_BROKER_URI_DEFAULT="mqtt://homeassistant.local"
CONFIG_MQTT_TOPIC_PREFIX="bekantx"
CONFIG_MQTT_DEVICE_ID="desk001"
CONFIG_MQTT_KEEPALIVE_SEC=60
CONFIG_MQTT_CMD_QUEUE_DEPTH=8
CONFIG_MQTT_QOS=1
CONFIG_MQTT_HA_DISCOVERY_ENABLED=y
CONFIG_MQTT_HA_DISCOVERY_PREFIX="homeassistant"
CONFIG_MQTT_NVS_NAMESPACE="mqtt_cfg"

# Deep sleep defaults
CONFIG_BEKANTX_SLEEP_ENABLED=y
CONFIG_BEKANTX_SLEEP_WAKE_GPIO=9
CONFIG_BEKANTX_SLEEP_WAKE_LEVEL=0
```
